/**
 * @cliArgs --board "/ti/boards/CC3220SF_LAUNCHXL" --rtos "nortos" --product "simplelink_cc32xx_sdk@6.10.00.05"
 * @versions {"tool":"1.12.0+2406"}
 */

/**
 * Import the modules used in this configuration.
 */
const GPIO   = scripting.addModule("/ti/drivers/GPIO");
const GPIO1  = GPIO.addInstance();
const GPIO2  = GPIO.addInstance();
const GPIO3  = GPIO.addInstance();
const I2C    = scripting.addModule("/ti/drivers/I2C", {}, false);
const I2C1   = I2C.addInstance();
const Power  = scripting.addModule("/ti/drivers/Power");
const Timer  = scripting.addModule("/ti/drivers/Timer", {}, false);
const Timer1 = Timer.addInstance();
const Timer2 = Timer.addInstance();
const UART2  = scripting.addModule("/ti/drivers/UART2", {}, false);
const UART21 = UART2.addInstance();

/**
 * Write custom configuration values to the imported modules.
 */
GPIO1.$hardware = system.deviceData.board.components.SW2;
GPIO1.$name     = "BUTTON_SW2";

GPIO2.$hardware = system.deviceData.board.components.SW3;
GPIO2.$name     = "BUTTON_SW3";

GPIO3.$hardware = system.deviceData.board.components.LED_RED;
GPIO3.$name     = "LED_RED_D10";

I2C1.$hardware          = system.deviceData.board.components.LP_I2C;
I2C1.$name              = "I2C_TP1";
I2C1.i2c.sdaPin.$assign = "boosterpack.10";

Power.parkPins.$name = "ti_drivers_power_PowerCC32XXPins0";

Timer1.$name     = "CONFIG_TIMER_0";
Timer1.timerType = "32 Bits";

Timer2.$name     = "CONFIG_TIMER_1";
Timer2.timerType = "32 Bits";

UART21.$name     = "CONFIG_UART2_0";
UART21.$hardware = system.deviceData.board.components.XDS110UART;

/**
 * Pinmux solution for unlocked pins/peripherals. This ensures that minor changes to the automatic solver in a future
 * version of the tool will not impact the pinmux you originally saw.  These lines can be completely deleted in order to
 * re-solve from scratch.
 */
GPIO1.gpioPin.$suggestSolution            = "boosterpack.3";
GPIO2.gpioPin.$suggestSolution            = "boosterpack.11";
GPIO3.gpioPin.$suggestSolution            = "boosterpack.29";
I2C1.i2c.$suggestSolution                 = "I2C0";
I2C1.i2c.sclPin.$suggestSolution          = "boosterpack.9";
Timer1.timer.$suggestSolution             = "Timer1";
Timer2.timer.$suggestSolution             = "Timer0";
UART21.uart.$suggestSolution              = "UART0";
UART21.uart.txPin.$suggestSolution        = "ball.55";
UART21.uart.txDmaChannel.$suggestSolution = "UDMA_CH9";
UART21.uart.rxPin.$suggestSolution        = "ball.57";
UART21.uart.rxDmaChannel.$suggestSolution = "UDMA_CH8";
